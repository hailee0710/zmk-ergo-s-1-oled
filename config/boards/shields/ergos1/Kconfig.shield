## config/boards/shields/ergos1/Kconfig.shield
```kconfig
# Copyright (c) 2020 The ZMK Contributors
# SPDX-License-Identifier: MIT

config SHIELD_ERGOS1_CENTRAL_DONGLE
    def_bool $(shields_list_contains,ergos1_central_dongle)

config SHIELD_ERGOS1_CENTRAL_LEFT
    def_bool $(shields_list_contains,ergos1_central_left)
    
config SHIELD_ERGOS1_PERIPHERAL_LEFT
    def_bool $(shields_list_contains,ergos1_peripheral_left)

config SHIELD_ERGOS1_PERIPHERAL_RIGHT
    def_bool $(shields_list_contains,ergos1_peripheral_right)
```

## config/west.yml
```yaml
manifest:
  remotes:
    - name: zmkfirmware
      url-base: https://github.com/zmkfirmware
    - name: inorichi
      url-base: https://github.com/inorichi
    - name: englmaxi
      url-base: https://github.com/englmaxi
  projects:
    - name: zmk
      remote: zmkfirmware
      revision: main
      import: app/west.yml
    - name: zmk-config
      remote: englmaxi
      revision: master
  self:
    path: config
    
```
